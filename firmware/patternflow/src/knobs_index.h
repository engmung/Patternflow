// ═══════════════════════════════════════════════════════════
// PatternFlow - /knobs page (served by core_knobs_http.h)
// Same cream/ink/LED tokens as the other consoles; no external assets.
// License: MIT
// ═══════════════════════════════════════════════════════════
// The page body below is generated from console/knobs.html — edit that,
// then run: python firmware/toolchain/console_pages.py build
#pragma once

#include <Arduino.h>

static const char KNOBS_INDEX_HTML[] PROGMEM = R"HTML(<!doctype html>
<html lang="en">
<head><meta charset="utf-8">
<script src="/pf-console.js?h=efffd505"></script><script>if(!window.PF)(function(){var W=window,U='/api/status',L=[],M=2e9,S,Z,P=W.PF={state:'live',dirty:!1,v:null,get:G,inflight:Number,hold:Object,say:function(t,k,e){e&&(e.textContent=t)},busy:function(b,p){function f(){b.disabled=!1}b.disabled=!0;p.then(f,f);return p},poll:function(s,m,c,o){var t,f,g=1;function R(){g&&!f&&(f=1,clearTimeout(t),(s.call?s():G(s)).then(function(d){c(d,null)},function(e){c(null,e)}).then(K,K))}function K(){f=0;clearTimeout(t);g&&(t=setTimeout(R,m))}o&&o.first===!1?K():R();return{stop:function(){g=0;clearTimeout(t)},set:function(n){m=n;f||K()},now:R}},status:function(c){c&&L.push(c);S?c&&c(S):Z?Z.now():Z=P.poll(U,M,D)},watchStatus:function(m){P.status();Z.set(M=Math.min(m,M))},waitForDevice:function(o){o=o||{};return new Promise(function(y,n){var h=P.poll(U,2e3,function(s){s&&!(o.build&&s.build==o.build)&&(h.stop(),y(s))});setTimeout(function(){h.stop();n(Error('timeout'))},o.timeout||9e4)})}};function G(u,o){return fetch(u,o).then(function(r){if(!r.ok)throw Error(r.status);return o&&o.text?r.text():r.json()})}function D(s){if(s){S=W.pfStatus=s;L.forEach(function(f){f(s)})}}})()</script>
<meta name="viewport" content="width=device-width,initial-scale=1">
<title>Patternflow - Knobs</title>
<style>
/* Console base: the same block opens every core page. Light in :root (the chrome's
   injected light palette holds these same values: keep the two in step),
   dark under html[data-theme=dark]. No web fonts: the hotspot has no internet. */
:root{color-scheme:light;--cream:#F4EFE6;--panel:#FFFCFA;--ink:#1A1814;--muted:#625C51;--faint:#7D7668;--rule:#DDD5C6;--rule-soft:#E8E1D4;--ghost:#E3DCCE;--led:#FF5C2E;--bad:#B83C1C;--ok:#2B7A4B;--warn:#85600E;
--sans:system-ui,-apple-system,'Segoe UI',Roboto,sans-serif;--mono:ui-monospace,'Cascadia Mono','SF Mono',Menlo,Consolas,'Roboto Mono',monospace}
html[data-theme=dark]{color-scheme:dark;--cream:#0C0B09;--panel:#131110;--ink:#EDE7DB;--muted:#A39B8A;--faint:#7A7364;--rule:#2B2721;--rule-soft:#1F1C18;--ghost:#2A2620;--bad:#FF7A55;--ok:#57B87F;--warn:#D9A03F}
*{box-sizing:border-box}[hidden]{display:none!important}
body{margin:0;background:var(--cream);color:var(--ink);font:15px/1.5 var(--sans);-webkit-font-smoothing:antialiased}
a{color:inherit}:focus-visible{outline:2px solid var(--led);outline-offset:2px}
.wrap{max-width:720px;margin:0 auto;padding:20px 16px 48px}
.btn{display:inline-flex;align-items:center;justify-content:center;gap:6px;min-height:40px;padding:0 16px;border:1px solid var(--rule);border-radius:8px;background:var(--panel);color:var(--ink);font:500 14px var(--sans);text-decoration:none;cursor:pointer;transition:border-color .15s,background .15s,color .15s}
@media(hover:hover){.btn:hover{border-color:var(--ink)}.btn.pri:hover{background:var(--led);border-color:var(--led);color:#fff}footer a:hover{color:var(--ink)}}
.btn:disabled{opacity:.45;cursor:default;border-color:var(--rule)}
.btn.pri{background:var(--ink);border-color:var(--ink);color:var(--cream)}
.msg{font:12px var(--mono);color:var(--faint)}.pf-ok{color:var(--ok)}.pf-err{color:var(--bad)}
footer{display:flex;align-items:center;justify-content:space-between;gap:16px;margin-top:40px;border-top:1px solid var(--rule);font:12px var(--mono);color:var(--faint)}
footer a{display:inline-flex;align-items:center;min-height:40px;color:var(--muted);text-decoration:none}
header{display:flex;align-items:baseline;flex-wrap:wrap;gap:4px 12px;margin-bottom:20px}
h1{flex:1;margin:0;font-size:22px;font-weight:600;letter-spacing:-.01em}
.sub{font:12px var(--mono);color:var(--faint)}
.note{margin:8px 0 0;font-size:13px;color:var(--muted)}
.acts{display:flex;flex-wrap:wrap;align-items:center;gap:8px;margin-top:12px}
select{width:100%;min-height:40px;padding:8px 10px;border:1px solid var(--rule);border-radius:8px;background:var(--panel);color:var(--ink);font:14px var(--sans)}
/* ── Knobs ── */
table{width:100%;margin-top:16px;border-collapse:collapse}
th,td{padding:6px 0 6px 8px;border-bottom:1px solid var(--rule-soft);text-align:left}
th{border-color:var(--rule);font-size:13px;font-weight:500;color:var(--muted)}
.k{width:28px;padding-left:0;font:600 12px var(--mono);color:var(--muted)}
.pos{width:76px;font:15px var(--mono)}
select.dirty{border-color:var(--led)}
tr.all td{border-color:var(--rule)}
.pf-offline .pos,.pf-offline #st{opacity:.5}
</style></head><body>
<main class="wrap">
<header><h1>Knobs</h1><span class="sub" id="st">-</span></header>
<p class="note">Turn a knob one click clockwise: its position should go up by one.</p>
<table>
  <thead><tr><th class="k"></th><th>Position</th><th>Direction</th><th>Edges per click</th></tr></thead>
  <tbody id="rows"><tr class="all"><td class="k">All</td><td class="pos"></td>
    <td><select id="invA" disabled><option value="">Mixed</option><option value="0">Normal</option><option value="1">Reversed</option></select></td>
    <td><select id="subA" disabled><option value="">Mixed</option><option>4</option><option>2</option><option>1</option></select></td></tr></tbody>
</table>
<div class="acts">
  <button class="btn pri" type="button" id="save" disabled>Save</button>
  <button class="btn" type="button" id="revert" disabled>Revert</button>
  <span class="msg" id="msg"></span>
</div>
<p class="note">Goes down: Reversed. Moves two, or needs two clicks to move one: change edges per click
(most encoders are 4; the count under the position is what one click makes). Saved on the panel; saving does not move a knob.</p>
<footer><a href="/">Console</a><a href="/status">Status</a></footer>
</main>
<script>
function $(i){return document.getElementById(i)}
function say(t,k){PF.say(t,k||'info',$('msg'))}
var cur=null,dirty=false,saving=false; // the device's; an unsaved choice; a POST in flight
function selDir(i){return $('inv'+i)}
function selSub(i){return $('sub'+i)}
function build(){
  var tb=$('rows');
  for(var i=0;i<4;i++){
    var tr=document.createElement('tr');
    // disabled until a first reading gives a choice something to differ from
    tr.innerHTML='<td class="k">K'+(i+1)+'</td>'+
      '<td class="pos"><span id="pos'+i+'">-</span><div class="msg" id="raw'+i+'"></div></td>'+
      '<td><select id="inv'+i+'" disabled><option value="0">Normal</option><option value="1">Reversed</option></select></td>'+
      '<td><select id="sub'+i+'" disabled><option>4</option><option>2</option><option>1</option></select></td>';
    tb.appendChild(tr);
    selDir(i).onchange=selSub(i).onchange=marks;
  }
}
// All sets the four; it reads Mixed while they differ
function all(sel){
  return function(){var v=this.value;if(v)for(var i=0;i<4;i++)sel(i).value=v;marks()};
}
$('invA').onchange=all(selDir);$('subA').onchange=all(selSub);
function same(sel){var v=sel(0).value;for(var i=1;i<4;i++)if(sel(i).value!==v)return '';return v}
// PF.dirty (no version reload) while a choice differs from the device
function marks(){
  var any=false;
  for(var i=0;i<4;i++){
    var a=(selDir(i).value==='1')!==cur.inv[i],b=parseInt(selSub(i).value,10)!==cur.sub[i];
    selDir(i).className=a?'dirty':'';selSub(i).className=b?'dirty':'';
    any=any||a||b;
  }
  $('invA').value=same(selDir);$('subA').value=same(selSub);
  setDirty(any);
}
function setDirty(on){dirty=PF.dirty=on;$('save').disabled=!on||saving;$('revert').disabled=!on}
function show(d){
  cur=d;
  for(var i=0;i<4;i++){
    $('pos'+i).textContent=d.clicks[i];
    $('raw'+i).textContent=d.raw[i]+' edges';
    selDir(i).disabled=selSub(i).disabled=false;
    if(!dirty){
      selDir(i).value=d.inv[i]?'1':'0';
      selSub(i).value=String(d.sub[i]);
    }
  }
  // re-judged each reading: another tab may have saved
  $('invA').disabled=$('subA').disabled=false;
  if(dirty)marks();else{for(i=0;i<4;i++)selDir(i).className=selSub(i).className='';$('invA').value=same(selDir);$('subA').value=same(selSub)}
  $('st').textContent='live';
}
$('revert').onclick=function(){setDirty(false);if(cur)show(cur);say('')};
$('save').onclick=function(){
  var body=[];
  for(var i=0;i<4;i++){
    body.push('inv'+i+'='+selDir(i).value);
    body.push('sub'+i+'='+selSub(i).value);
  }
  saving=$('save').disabled=true;
  fetch('/api/knobs',{method:'POST',
    headers:{'Content-Type':'application/x-www-form-urlencoded'},body:body.join('&')})
    .then(function(r){return r.json()}).then(function(d){
      saving=false;
      if(!d.ok){say(d.error||'failed','err');$('save').disabled=false;return}
      setDirty(false);show(d);say('saved','ok');
    }).catch(function(){saving=false;say('failed - the panel did not answer','err');$('save').disabled=false});
};
build();
PF.poll('/api/knobs',400,function(d){if(d)show(d)});
</script></body></html>
)HTML";
// <gz:KNOBS_INDEX_HTML> GENERATED by firmware/toolchain/console_pages.py build — do not edit.
// gzip -9 of KNOBS_INDEX_HTML (8774 bytes → 3712 bytes), served with Content-Encoding: gzip.
static const uint8_t KNOBS_INDEX_HTML_GZ[] PROGMEM = {
  0x1f,0x8b,0x08,0x00,0x00,0x00,0x00,0x00,0x02,0xff,0xb5,0x5a,0xeb,0x72,0xdb,0x38,
  0x96,0xfe,0xaf,0xa7,0x40,0x94,0x59,0x93,0x6c,0x93,0x94,0xe8,0xf8,0x16,0x52,0x54,
  0xd6,0xd7,0xde,0xae,0xc4,0x3d,0xae,0x38,0x5d,0x53,0x95,0x54,0x7e,0x50,0x22,0x28,
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  0xc5,0x41,0x4f,0xff,0x57,0x23,0xff,0x05,0xcc,0x0c,0xb8,0x04,0x46,0x22,0x00,0x00,
};
constexpr size_t KNOBS_INDEX_HTML_GZ_LEN = sizeof(KNOBS_INDEX_HTML_GZ);
// </gz:KNOBS_INDEX_HTML>
